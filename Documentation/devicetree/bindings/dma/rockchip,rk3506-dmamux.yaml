## Documentation/devicetree/bindings/dma/rockchip,rk3506-dmamux.yaml
```yaml
# SPDX-License-Identifier: (GPL-2.0-only OR BSD-2-Clause)
%YAML 1.2
---
$id: http://devicetree.org/schemas/dma/rockchip,rk3506-dmamux.yaml#
$schema: http://devicetree.org/meta-schemas/core.yaml#

title: Rockchip RK3506 DMAC0 request-line multiplexer

maintainers:
  - Bas Vermeulen <bas.vermeulen@blackstar.nl>

description:
  Each request line of the first PL330 DMA controller of the RK3506 can be
  driven by one of up to four peripherals, selected by a two-bit field per
  line in the GRF. A peripheral names the request line it is wired to and
  the select value of that line in its dmas property.

allOf:
  - $ref: dma-router.yaml#

properties:
  compatible:
    const: rockchip,rk3506-dmamux

  '#dma-cells':
    const: 2
    description:
      The first cell is the DMAC0 request line, the second the value that
      selects the peripheral on that line.

  dma-masters:
    maxItems: 1

  dma-requests:
    description: Number of request lines of the DMA controller.
    default: 12

  rockchip,grf:
    $ref: /schemas/types.yaml#/definitions/phandle
    description: Phandle to the General Register Files holding the mux.

required:
  - compatible
  - '#dma-cells'
  - dma-masters
  - rockchip,grf

unevaluatedProperties: false

examples:
  - |
    dmamux0: dma-router {
        compatible = "rockchip,rk3506-dmamux";
        #dma-cells = <2>;
        dma-masters = <&dmac0>;
        rockchip,grf = <&grf>;
    };
```

## Documentation/devicetree/bindings/net/can/rockchip,rk3576-can.yaml
```yaml
# SPDX-License-Identifier: (GPL-2.0-only OR BSD-2-Clause)
%YAML 1.2
---
$id: http://devicetree.org/schemas/net/can/rockchip,rk3576-can.yaml#
$schema: http://devicetree.org/meta-schemas/core.yaml#

title: Rockchip RK3576-type CAN controller

maintainers:
  - Bas Vermeulen <bas.vermeulen@blackstar.nl>

description:
  Classic CAN controller found on the Rockchip RK3576, RK3506 and RV1126B
  SoCs, with an internal receive SRAM and an optional DMA drain of it.

allOf:
  - $ref: can-controller.yaml#

properties:
  compatible:
    oneOf:
      - const: rockchip,rk3576-can
      - items:
          - enum:
              - rockchip,rk3506-can
              - rockchip,rv1126b-can
          - const: rockchip,rk3576-can

  reg:
    maxItems: 1

  interrupts:
    maxItems: 1

  clocks:
    items:
      - description: bit-rate (functional) clock
      - description: APB bus clock

  clock-names:
    items:
      - const: baudclk
      - const: apb_pclk

  resets:
    items:
      - description: controller reset
      - description: APB bus reset

  reset-names:
    items:
      - const: can
      - const: can-apb

  dmas:
    maxItems: 1

  dma-names:
    const: rx

  rockchip,auto-retx-cnt:
    $ref: /schemas/types.yaml#/definitions/uint32
    description: automatic retransmission limit (0 = unlimited)
    maximum: 65535

  rockchip,rx-max-data:
    $ref: /schemas/types.yaml#/definitions/uint32
    description: receive SRAM slot size in words
    enum: [4, 18]

required:
  - compatible
  - reg
  - interrupts
  - clocks
  - clock-names
  - resets
  - reset-names

unevaluatedProperties: false

examples:
  - |
    #include <dt-bindings/interrupt-controller/arm-gic.h>
    #include <dt-bindings/interrupt-controller/irq.h>
    #include <dt-bindings/clock/rockchip,rk3506-cru.h>
    #include <dt-bindings/reset/rockchip,rk3506-cru.h>

    can@ff320000 {
        compatible = "rockchip,rk3506-can", "rockchip,rk3576-can";
        reg = <0xff320000 0x1000>;
        interrupts = <GIC_SPI 45 IRQ_TYPE_LEVEL_HIGH>;
        clocks = <&cru CLK_CAN0>, <&cru HCLK_CAN0>;
        clock-names = "baudclk", "apb_pclk";
        resets = <&cru SRST_CAN0>, <&cru SRST_H_CAN0>;
        reset-names = "can", "can-apb";
    };
```

## drivers/net/can/rockchip/Kconfig
```kconfig
# SPDX-License-Identifier: GPL-2.0

config CAN_ROCKCHIP_CANFD
	tristate "Rockchip CAN-FD controller"
	depends on OF
	depends on ARCH_ROCKCHIP || COMPILE_TEST
	select CAN_RX_OFFLOAD
	help
	  Say Y here if you want to use CAN-FD controller found on
	  Rockchip SoCs.

config CAN_ROCKCHIP_RK3576
	tristate "Rockchip RK3576-type CAN controller (RK3576, RK3506, RV1126B)"
	depends on OF
	depends on ARCH_ROCKCHIP || COMPILE_TEST
	help
	  Say Y here if you want to use the CAN controller found on the
	  Rockchip RK3576, RK3506 and RV1126B SoCs (classic CAN; this is
	  not the RK3568/RK3588 CAN-FD block handled by CAN_ROCKCHIP_CANFD).
```
